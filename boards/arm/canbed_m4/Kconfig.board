## boards/arm/canbed_m4/Kconfig.board
```kconfig
# CANBed M4 Board selection

# Copyright (c) 2022 Slawomir Ciesielski <slawomir.ciesielski@anyware.dev>
# SPDX-License-Identifier: Apache-2.0

config BOARD_CANBED_M4
	bool "CANBed M4"
	depends on SOC_PART_NUMBER_SAME51G19A
```

## boards/arm/canbed_m4/Kconfig.defconfig
```kconfig
# CANBed M4 Board configuration

# Copyright (c) 2022 Slawomir Ciesielski <slawomir.ciesielski@anyware.dev>
# SPDX-License-Identifier: Apache-2.0

if BOARD_CANBED_M4

config BOARD
	default "canbed_m4"

endif # BOARD_CANBED_M4
```

## boards/arm/canbed_m4/canbed_m4_defconfig
```kconfig
# SPDX-License-Identifier: Apache-2.0

CONFIG_SOC_SERIES_SAME51=y
CONFIG_SOC_PART_NUMBER_SAME51G19A=y
CONFIG_ARM_MPU=y
CONFIG_CORTEX_M_SYSTICK=y
CONFIG_CONSOLE=y
CONFIG_UART_CONSOLE=y
CONFIG_SERIAL=y
CONFIG_UART_SAM0=y
CONFIG_BOARD_CANBED_M4=y
CONFIG_GPIO=y
CONFIG_WDT_DISABLE_AT_BOOT=y

# Enable HW stack protection
CONFIG_HW_STACK_PROTECTION=y
```

## boards/riscv/t_oi_plus/Kconfig.board
```kconfig
# ESP32C3 devkitm board configuration

# Copyright (c) 2021 Espressif Systems (Shanghai) Co., Ltd.
# SPDX-License-Identifier: Apache-2.0

config BOARD_T_OI_PLUS
	bool "ESP32C3 T-OI PLUS Board"
	depends on SOC_ESP32C3
	select CONSOLE_HAS_DRIVER
```

## boards/riscv/t_oi_plus/Kconfig.defconfig
```kconfig
# ESP32C3 devkitm board configuration

# Copyright (c) 2021 Espressif Systems (Shanghai) Co., Ltd.
# SPDX-License-Identifier: Apache-2.0

config BOARD
	default "t_oi_plus"
	depends on BOARD_T_OI_PLUS

config HEAP_MEM_POOL_SIZE
	default 98304 if WIFI
	default 16384 if BT
	default 4096

if BT

choice BT_HCI_BUS_TYPE
	default BT_ESP32
endchoice

endif # BT
```

## soc/arm/atmel_sam0/same51/Kconfig.soc
```kconfig
# Atmel SAME51 MCU series

# Copyright (c) 2019 ML!PA Consulting GmbH
# SPDX-License-Identifier: Apache-2.0

choice
	prompt "Atmel SAME51 MCU Selection"
	depends on SOC_SERIES_SAME51

config SOC_PART_NUMBER_SAME51G18A
	bool "SAME51G18A"

config SOC_PART_NUMBER_SAME51G19A
	bool "SAME51G19A"

config SOC_PART_NUMBER_SAME51G20A
	bool "SAME51G20A"

config SOC_PART_NUMBER_SAME51J18A
	bool "SAME51J18A"

config SOC_PART_NUMBER_SAME51J19A
	bool "SAME51J19A"

config SOC_PART_NUMBER_SAME51J20A
	bool "SAME51J20A"

config SOC_PART_NUMBER_SAME51N19A
	bool "SAME51N19A"

config SOC_PART_NUMBER_SAME51N20A
	bool "SAME51N20A"

endchoice
```
